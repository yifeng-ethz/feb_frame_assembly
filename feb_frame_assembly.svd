# MU3E_FEB_FRAME_ASSEMBLY register map
Vendor: Mu3e; Series: MU3E_FPGA_IP; File version: 26.0.328
CMSIS-SVD description of the feb_frame_assembly CSR window. This conservative first-pass schema exposes the 16-word relative aperture as read-only WORD registers until the IP author publishes the exact control/status fields intended for software.
Registers are 32-bit, read-only, reset 0x0 unless marked. A register's access mark holds for its fields unless they carry their own. Offsets are from the block's base; lines under a group give offsets from that group; [hi:lo] are bit positions; {n}, {i} and the like mark numbered series; 'fields as' and 'values as' point back to an identical list; <NAME> marks a mode.

## Memory map
0x00000000 FEB_FRAME_ASSEMBLY_CSR size 0x40 — Relative 16-word CSR aperture for FEB frame assembly.

## FEB_FRAME_ASSEMBLY_CSR — Relative 16-word CSR aperture for FEB frame assembly.
Base 0x00000000
{0x0+4i} WORD{i:03} (i=0..15) — FEB frame assembly CSR word {i}.
  [31:0] value — Raw FEB frame assembly CSR word {i}.
